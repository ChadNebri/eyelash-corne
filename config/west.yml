## config/west.yml
```yaml
manifest:
  remotes:
    - name: zmkfirmware
      url-base: https://github.com/zmkfirmware
      # Additional modules containing boards/shields/custom code can be listed here as well.
      # See:
      # - https://zmk.dev/docs/features/modules
      # - https://docs.zephyrproject.org/3.5.0/develop/west/manifest.html#projects
    - name: petejohanson
      url-base: https://github.com/petejohanson
    - name: crizzy9
      url-base: http://github.com/crizzy9
    - name: chad-nebri         # 👈 added this (name can be anything unique)
      url-base: https://github.com/ChadNebri
  projects:
    - name: zmk
      remote: petejohanson
      revision: feat/pointers-with-input-processors
      import: app/west.yml
    - name: nice-shield-spacemarine    # 👈 added this
      remote: chad-nebri
      revision: main
  self:
    path: config
```
